## profiles/reconnect_20261124/src/sdkconfig.defaults
```kconfig
CONFIG_ESPTOOLPY_FLASHSIZE_8MB=y
CONFIG_PARTITION_TABLE_CUSTOM=y
CONFIG_PARTITION_TABLE_CUSTOM_FILENAME="partitions.csv"
CONFIG_WOLFSSL_HAVE_ALPN=y
CONFIG_WOLFSSL_ALLOW_TLS13=y
# CONFIG_WOLFSSL_ALLOW_TLS12 is not set
CONFIG_WOLFSSL_HAVE_TLS_EXTENSIONS=y
```
